## boards/shields/ghosty62/Kconfig.defconfig
```kconfig
if SHIELD_GHOSTY_LEFT

# Name must be less than 16 characters long!
config ZMK_KEYBOARD_NAME
    default "Ghosty62"

config ZMK_SPLIT_ROLE_CENTRAL
    default y

endif

if SHIELD_GHOSTY_LEFT || SHIELD_GHOSTY_RIGHT

config ZMK_SPLIT
    default y

endif
```

## boards/shields/ghosty62/Kconfig.shield
```kconfig
config SHIELD_GHOSTY_LEFT
    def_bool $(shields_list_contains,ghosty62_left)

config SHIELD_GHOSTY_RIGHT
    def_bool $(shields_list_contains,ghosty62_right)
```
